## conf/layer.conf
```bitbake
BBPATH := "${BBPATH}:${LAYERDIR}"

BBFILES := "${BBFILES} ${LAYERDIR}/recipes-*/*/*.bb \
           ${LAYERDIR}/recipes-*/*/*.bbappend \
           ${LAYERDIR}/images/*.bb*"


BBFILE_COLLECTIONS += "gyroidos-nxp"
BBFILE_PATTERN_gyroidos-nxp := "^${LAYERDIR}/"
BBFILE_PRIORITY_gyroidos-nxp := "8"

LAYERDEPENDS_gyroidos-layer = "freescale-layer"

LAYERSERIES_COMPAT_gyroidos-nxp = "kirkstone scarthgap"

BBFILES_DYNAMIC += "\
	toradex-nxp-layer:${LAYERDIR}/dynamic-layers/toradex-nxp-layer/*/*/*.bb* \
	tq-layer:${LAYERDIR}/dynamic-layers/tq-layer/*/*/*.bb* \
"
```
